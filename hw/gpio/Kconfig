## hw/gpio/Kconfig
```kconfig
config PL061
    bool

config GPIO_KEY
    bool

config GPIO_MPC8XXX
    bool

config GPIO_PWR
    bool

config SIFIVE_GPIO_C
    bool

config SIFIVE_GPIO
    bool
    # The PL011 has both a Rust and a C implementation
    select SIFIVE_GPIO_C if !HAVE_RUST
    select X_SIFIVE_GPIO_RUST if HAVE_RUST

config GEVICO_GPIO
    bool

config STM32L4X5_GPIO
    bool

config PCA9552
    bool
    depends on I2C

config PCA9554
    bool
    depends on I2C

config PCF8574
    bool
    depends on I2C

config ZAURUS_SCOOP
    bool
```

## rust/hw/Kconfig
```kconfig
# devices Kconfig
source char/Kconfig
source i2c/Kconfig
source timer/Kconfig
source gpio/Kconfig
```
